// Running the Sobel filter on the RVfpga and printing the results via UART
// Author: Junze Jiang
// 2026.4.1

// Uplode the bitstream of the board and build the code to check sobel.c, main.c, image_data.h are normal
// Click "upload" or "debug"

// This version uses the Sobel hardware accelerator (DMA + Engine)
// via Wishbone CSR registers, and measures execution time using
// the SweRVolf syscon mtime counter.

// How to use:
//   1. Put this file into  Sobel_Accelerator/src/main.c
//   2. Build & upload using the SoC bitstream WITH accelerator
//   3. Open PlatformIO Serial Monitor (baud 115200)
//   4. You will see the cycle count printed via UART

// Memory note:
//   The accelerator's DMA reads/writes data via AXI from main
//   memory (0x00000000 – 0x07FFFFFF). The input[] and edges[]
//   arrays must reside in AXI-accessible RAM (not DCCM).
//   If the image data is in DCCM, you need to first copy it
//   into a RAM-resident buffer.

// BSP provided by RVfpga
#if defined(D_NEXYS_A7)
   #include <bsp_printf.h>
   #include <bsp_mem_map.h>
   #include <bsp_version.h>
#else
   PRE_COMPILED_MSG("no platform was defined")
#endif
#include <psp_api.h>

#include <stdint.h>
#include <stdio.h>
#include "sobel.h"
#include "image_data.h"  // Generated by image_to_matrix.py (128x128 grayscale)

//  mtime register addresses (SweRVolf syscon)
//  syscon base = 0x80001000, mtime offset = 0x20
#define MTIME_LOW   (*(volatile uint32_t *)0x80001020)  // mtime[31:0]
#define MTIME_HIGH  (*(volatile uint32_t *)0x80001024)  // mtime[63:32]

// Read the full 64-bit mtime value
static inline uint64_t read_mtime(void) {
    uint32_t lo, hi1, hi2;
    do {
        hi1 = MTIME_HIGH;
        lo  = MTIME_LOW;
        hi2 = MTIME_HIGH;
    } while (hi1 != hi2);
    return ((uint64_t)hi1 << 32) | lo;
}

//  Sobel Accelerator CSR registers (Wishbone slave)
//  Base address: 0x80001600 (from wb_intercon.v MATCH_ADDR)
//
//  Register map (from csr_wb.v):
//    0x00 CTRL        [0]=start(W1P), [1]=clear done, [2]=clear error
//    0x04 SRC_BASE    source base address (in AXI address space)
//    0x08 DST_BASE    destination base address (in AXI address space)
//    0x0C PIXEL_COUNT number of pixels to process
//    0x10 STATUS      [0]=busy, [1]=done, [2]=error
//    0x14 THRESHOLD   [7:0]=sobel threshold
#define SOBEL_ACC_BASE      0x80001600

#define SOBEL_CTRL          (*(volatile uint32_t *)(SOBEL_ACC_BASE + 0x00))
#define SOBEL_SRC_BASE      (*(volatile uint32_t *)(SOBEL_ACC_BASE + 0x04))
#define SOBEL_DST_BASE      (*(volatile uint32_t *)(SOBEL_ACC_BASE + 0x08))
#define SOBEL_PIXEL_COUNT   (*(volatile uint32_t *)(SOBEL_ACC_BASE + 0x0C))
#define SOBEL_STATUS        (*(volatile uint32_t *)(SOBEL_ACC_BASE + 0x10))
#define SOBEL_THRESHOLD     (*(volatile uint32_t *)(SOBEL_ACC_BASE + 0x14))

// Status register bit masks
#define STATUS_BUSY   (1u << 0)
#define STATUS_DONE   (1u << 1)
#define STATUS_ERROR  (1u << 2)


//  Buffers — must be in AXI-accessible RAM

// Copy of input image in writable RAM (needed because 'input'
// from image_data.h is const and may be in read-only memory)
static uint8_t src_buf[IMG_W * IMG_H];

// Output buffer for the accelerator result
static uint8_t edges_hw[IMG_W * IMG_H];

// Output buffer for CPU-only result (for comparison)
static uint8_t edges_sw[IMG_W * IMG_H];


int main(void) {
    int i;
    const uint8_t threshold = 60;
    uint32_t status;

    // Initialise the serial port
    uartInit();

    printfNexys("\n");
    printfNexys("========================================\n");
    printfNexys("  Sobel Benchmark: CPU vs Accelerator\n");
    printfNexys("  Image: %d x %d, threshold=%d\n",
                (int)IMG_W, (int)IMG_H, (int)threshold);
    printfNexys("========================================\n");

    // Copy input image into writable RAM buffer
    for (i = 0; i < IMG_W * IMG_H; i++) {
        src_buf[i] = input[i];
    }

    // TEST 1: CPU-only software Sobel (baseline)
    printfNexys("\n--- [TEST 1] CPU-only software Sobel ---\n");

    uint64_t t0_sw = read_mtime();

    sobel_edge(src_buf, edges_sw, IMG_W, IMG_H, threshold);

    uint64_t t1_sw = read_mtime();
    uint32_t cycles_sw = (uint32_t)(t1_sw - t0_sw);

    printfNexys("CPU-only cycles: %u\n", cycles_sw);

    // TEST 2: Hardware accelerator Sobel
    printfNexys("\n--- [TEST 2] Hardware Accelerator Sobel ---\n");

    // Clear any previous done/error flags
    SOBEL_CTRL = 0x06;  // bit[1]=clear done, bit[2]=clear error

    // Configure the accelerator
    SOBEL_SRC_BASE    = (uint32_t)src_buf;       // source image address
    SOBEL_DST_BASE    = (uint32_t)edges_hw;      // destination image address
    SOBEL_PIXEL_COUNT = IMG_W * IMG_H;           // 128 * 128 = 16384
    SOBEL_THRESHOLD   = threshold;               // 60

    printfNexys("SRC_BASE  = 0x%08X\n", (uint32_t)src_buf);
    printfNexys("DST_BASE  = 0x%08X\n", (uint32_t)edges_hw);
    printfNexys("PIX_COUNT = %u\n", (unsigned)(IMG_W * IMG_H));

    // ---- Start timing ----
    uint64_t t0_hw = read_mtime();

    // Trigger the accelerator
    SOBEL_CTRL = 0x01;  // bit[0]=start

    // Poll STATUS until done or error
    do {
        status = SOBEL_STATUS;
    } while (!(status & (STATUS_DONE | STATUS_ERROR)));

    // ---- End timing ----
    uint64_t t1_hw = read_mtime();
    uint32_t cycles_hw = (uint32_t)(t1_hw - t0_hw);

    if (status & STATUS_ERROR) {
        printfNexys("!!! ACCELERATOR ERROR (STATUS=0x%08X) !!!\n", status);
    } else {
        printfNexys("Accelerator cycles: %u\n", cycles_hw);
    }

    // Clear done flag
    SOBEL_CTRL = 0x02;

    // RESULTS COMPARISON
    printfNexys("\n========================================\n");
    printfNexys("  RESULTS\n");
    printfNexys("========================================\n");
    printfNexys("CPU-only cycles      : %u\n", cycles_sw);
    printfNexys("Accelerator cycles   : %u\n", cycles_hw);

    // Calculate speedup (integer approximation)
    if (cycles_hw > 0) {
        uint32_t speedup_x10 = (cycles_sw * 10) / cycles_hw;
        printfNexys("Speedup              : %u.%ux\n",
                    speedup_x10 / 10, speedup_x10 % 10);
    }

    // Verify correctness: compare SW vs HW output
    uint32_t mismatches = 0;
    for (i = 0; i < IMG_W * IMG_H; i++) {
        if (edges_sw[i] != edges_hw[i]) {
            mismatches++;
            if (mismatches <= 5) {
                printfNexys("  MISMATCH at [%d]: SW=%u, HW=%u\n",
                            i, edges_sw[i], edges_hw[i]);
            }
        }
    }

    if (mismatches == 0) {
        printfNexys("Output match         : PASS (0 mismatches)\n");
    } else {
        printfNexys("Output match         : FAIL (%u mismatches)\n", mismatches);
    }

    printfNexys("========================================\n");
    printfNexys("=== Test Complete ===\n");

    // Output all edge data for visualisation by view_edges.py
    printfNexys("\n--- EDGE DATA START ---\n");
    for (i = 0; i < IMG_W * IMG_H; i++) {
        printfNexys("%u ", edges_sw[i]);
    }
    printfNexys("\n--- EDGE DATA END ---\n");

    while (1) {
        for (i = 0; i < 10000000; i++) {}
    }

    return 0;
}
